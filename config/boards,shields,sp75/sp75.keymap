 /*
  * Copyright (c) 2020 The ZMK Contributors
  *
  * SPDX-License-Identifier: MIT
  */

  #include <behaviors.dtsi>
  #include <dt-bindings/zmk/keys.h>
  #include <dt-bindings/zmk/bt.h>
  #include <dt-bindings/zmk/ext_power.h>

  / {
    keymap {
      compatible = "zmk,keymap";
  layer0 {
          bindings = <
          &kp LOCKING_NUM &kp KP_SLASH &kp KP_ASTERISK &kp KP_MINUS &kp ESCAPE &kp N1 &kp N2 &kp N3 &kp N4 &kp N5 &kp N6 &kp N7 &kp N8 &kp N9 &kp N0 &kp MINUS &kp EQUAL &kp BACKSPACE &kp KP_N7 &kp KP_N8 &kp KP_N9 &kp KP_PLUS &kp TAB &kp Q &kp W &kp E &kp R &kp T &kp Y &kp U &kp I &kp O &kp P &kp LEFT_BRACKET &kp RIGHT_BRACKET &kp BACKSLASH &kp KP_N4 &kp KP_N5 &kp KP_N6 &kp CAPSLOCK &kp A &kp S &kp D &kp F &kp G &kp H &kp J &kp K &kp L &kp SEMICOLON &kp SINGLE_QUOTE &kp ENTER &kp KP_N1 &kp KP_N2 &kp KP_N3 &kp KP_ENTER &kp LEFT_SHIFT &kp Z &kp X &kp C &kp V &kp B &kp N &kp M &kp COMMA &kp DOT &kp SLASH &kp LEFT_SHIFT &kp KP_N0 &kp KP_DOT &kp LEFT_CONTROL &kp LEFT_GUI &kp LEFT_ALT &kp SPACE &kp LEFT_ALT &kp LEFT_GUI &kp C_MENU &kp LEFT_CONTROL
          >;
        };
    };
  };
